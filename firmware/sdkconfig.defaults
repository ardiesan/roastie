## firmware/sdkconfig.defaults
```kconfig
CONFIG_ESP_TASK_WDT=y
CONFIG_ESP_TASK_WDT_TIMEOUT_S=30
CONFIG_SPIRAM_USE_MALLOC=y
CONFIG_SPIRAM_MALLOC_ALWAYSINTERNAL=4096
CONFIG_FREERTIC_HZ=1000
CONFIG_ESP_MAIN_TASK_STACK_SIZE=6144
# Camera
CONFIG_OV2640_SUPPORT=y
CONFIG_GC032A_SUPPORT=n
# I2S
CONFIG_I2S_ISR_IRAM_SAFE=y
# Wi-Fi
CONFIG_ESP_WIFI_SOFTMAX_CONN=1
```
